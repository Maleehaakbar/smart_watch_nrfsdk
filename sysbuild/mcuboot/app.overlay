/*Include overlay file from the application  */
#include "../../boards/nrf52840dk_nrf52840.overlay"

/ {
	chosen {
		zephyr,code-partition = &boot_partition;
	};
};


/*partitions will be shown in memory report if partition manager is enabled or
configure in prj.conf*/


