## modules/drivers/dts/bindings/sensor/qmc5883l,sensor.yaml
```yaml
description: QMC5883L 3-axis magnetometer sensor

compatible: "qmc5883l,sensor"

include: [sensor-device.yaml, i2c-device.yaml]
```

## modules/drivers/qmc5883l/Kconfig
```kconfig
config ENABLE_QMC5883L_SENSOR
  bool "enable magnetometer"
  default y
  help
    enable or disable sensor module
config QMC5883L_RANGE
    int "enter range"
    default 2000
    help
      Magnetometer full-scale range
      Valid values: 2000 or 8000 (Gauss).

config QMC5883L_ODR
    int "Output data rate (Hz)"
	  default 50
	  help
	    Magnetometer output data rate in Hz.
	    Typical values: 10, 50, 100, 200.

config QMC5883L_OSR
    int "Over-sample ratio"
	  default 128
	  help
	    Magnetometer over-sampling ratio.
	    Typical values: 64, 128, 256, 512.
```

## modules/test_folder/Kconfig
```kconfig
config ENABLE_TEST
  bool "enable external module"
  default y
  help
    test module enable or disable
config NUM_A
    int "enter 1st number"
    default 10
    help
      taking sum of two numbers

config NUM_B
    int "enter 2nd number"
    default 8
    help
      taking sum of two numbers
```

## src/app/src/Kconfig
```kconfig
menu "ZSW Application"
    module = ZSW_APP
    module-str = "ZSW Application"
    source "subsys/logging/Kconfig.template.log_config"

    config ENABLE_QMC_CALIBRATION
        depends on ENABLE_QMC5883L_SENSOR
        bool "enable or disable calibration"
        default y
        help
            enable or disable sensor module

    config USE_RAW_MAGNETOMETER_DATA
        bool "use raw data or calibrated data"
        default y
        help
            use raw data or calibrated data of measurements
    
    config ENABLE_IMU
        bool "Enable or disable accel and gyro"
        default y
        help
            Enable or disable accel and gyro
    

endmenu
```
